#include <dt-bindings/zmk/outputs.h>
#include <dt-bindings/zmk/bt.h>
#include <behaviors.dtsi>
#include <dt-bindings/zmk/keys.h>

/ {
    //compatible = "zmk,shield-k1012-left";

    chosen {
        zmk,kscan = &kscan_direct;
    };

    kscan_direct: kscan {
        compatible = "zmk,kscan-gpio-direct";
        label = "KSCAN_DIRECT";

        input-gpios
            = <&gpio0 19 GPIO_ACTIVE_LOW>
            , <&gpio0 18 GPIO_ACTIVE_LOW>
            , <&gpio0 30 GPIO_ACTIVE_LOW>
            , <&gpio0 35 GPIO_ACTIVE_LOW>
            , <&gpio0 47 GPIO_ACTIVE_LOW>
            , <&gpio0 4  GPIO_ACTIVE_LOW>
            , <&gpio0 8  GPIO_ACTIVE_LOW>
            , <&gpio0 26 GPIO_ACTIVE_LOW>
            , <&gpio0 21 GPIO_ACTIVE_LOW>
            , <&gpio0 20 GPIO_ACTIVE_LOW>
            , <&gpio0 27 GPIO_ACTIVE_LOW>
            , <&gpio0 33 GPIO_ACTIVE_LOW>
            , <&gpio0 46 GPIO_ACTIVE_LOW>
            , <&gpio0 0  GPIO_ACTIVE_LOW>
            , <&gpio0 12 GPIO_ACTIVE_LOW>
            , <&gpio0 6  GPIO_ACTIVE_LOW>
            , <&gpio0 22 GPIO_ACTIVE_LOW>
            , <&gpio0 17 GPIO_ACTIVE_LOW>
            , <&gpio0 29 GPIO_ACTIVE_LOW>
            , <&gpio0 34 GPIO_ACTIVE_LOW>
            , <&gpio0 45 GPIO_ACTIVE_LOW>
            , <&gpio0 1  GPIO_ACTIVE_LOW>
            , <&gpio0 9  GPIO_ACTIVE_LOW>
            , <&gpio0 44 GPIO_ACTIVE_LOW>
            , <&gpio0 23 GPIO_ACTIVE_LOW>
            , <&gpio0 16 GPIO_ACTIVE_LOW>
            , <&gpio0 31 GPIO_ACTIVE_LOW>
            , <&gpio0 36 GPIO_ACTIVE_LOW>
            , <&gpio0 37 GPIO_ACTIVE_LOW>
            , <&gpio0 7  GPIO_ACTIVE_LOW>
            , <&gpio0 10 GPIO_ACTIVE_LOW>
            , <&gpio0 28 GPIO_ACTIVE_LOW>
            , <&gpio0 24 GPIO_ACTIVE_LOW>
            , <&gpio0 15 GPIO_ACTIVE_LOW>
            ;
    };
};
