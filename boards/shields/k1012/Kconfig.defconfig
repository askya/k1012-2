## boards/shields/k1012/Kconfig.defconfig
```kconfig
if SHIELD_K1012_LEFT

# Name must be less than 16 characters long!
config ZMK_KEYBOARD_NAME
    default "k1012"

config ZMK_SPLIT_ROLE_CENTRAL
    default y

endif

if SHIELD_K1012_LEFT || SHIELD_K1012_RIGHT

config ZMK_SPLIT
    default y

endif
```

## boards/shields/k1012/Kconfig.shield
```kconfig
config SHIELD_K1012_LEFT
    def_bool $(shields_list_contains,k1012_left)

config SHIELD_K1012_RIGHT
    def_bool $(shields_list_contains,k1012_right)
```
