/dts-v1/;
#include <behaviors.dtsi>
#include <dt-bindings/zmk/keys.h>

/ {
    compatible = "zmk,shield-k1012-right";

    chosen {
        zmk,kscan = &kscan0;
    };

    kscan0: kscan {
        compatible = "zmk,kscan-gpio-direct";
        label = "KSCAN";

        input-gpios
            = <&gpio0 26 GPIO_ACTIVE_LOW>
            , <&gpio0 33 GPIO_ACTIVE_LOW>
            , <&gpio0 14 GPIO_ACTIVE_LOW>
            , <&gpio0 0  GPIO_ACTIVE_LOW>
            , <&gpio0 7  GPIO_ACTIVE_LOW>
            , <&gpio0 43 GPIO_ACTIVE_LOW>
            , <&gpio0 20 GPIO_ACTIVE_LOW>
            , <&gpio0 18 GPIO_ACTIVE_LOW>
            , <&gpio0 27 GPIO_ACTIVE_LOW>
            , <&gpio0 29 GPIO_ACTIVE_LOW>
            , <&gpio0 16 GPIO_ACTIVE_LOW>
            , <&gpio0 2  GPIO_ACTIVE_LOW>
            , <&gpio0 8  GPIO_ACTIVE_LOW>
            , <&gpio0 41 GPIO_ACTIVE_LOW>
            , <&gpio0 35 GPIO_ACTIVE_LOW>
            , <&gpio0 21 GPIO_ACTIVE_LOW>
            , <&gpio0 28 GPIO_ACTIVE_LOW>
            , <&gpio0 34 GPIO_ACTIVE_LOW>
            , <&gpio0 15 GPIO_ACTIVE_LOW>
            , <&gpio0 1  GPIO_ACTIVE_LOW>
            , <&gpio0 10 GPIO_ACTIVE_LOW>
            , <&gpio0 42 GPIO_ACTIVE_LOW>
            , <&gpio0 36 GPIO_ACTIVE_LOW>
            , <&gpio0 19 GPIO_ACTIVE_LOW>
            , <&gpio0 25 GPIO_ACTIVE_LOW>
            , <&gpio0 32 GPIO_ACTIVE_LOW>
            , <&gpio0 17 GPIO_ACTIVE_LOW>
            , <&gpio0 4  GPIO_ACTIVE_LOW>
            , <&gpio0 5  GPIO_ACTIVE_LOW>
            , <&gpio0 45 GPIO_ACTIVE_LOW>
            , <&gpio0 37 GPIO_ACTIVE_LOW>
            , <&gpio0 22 GPIO_ACTIVE_LOW>
            ;
    };
};
